#define BLYNK_PRINT Serial //this is the debugging for Blynk
#include <ESP8266WiFi.h>
#include <BlynkSimpleEsp8266.h>
#include <SimpleTimer.h>

WiFiClient client;

const char* ssid = "Maker Ha Noi";
const char* password = "makerhanoi123";

const char* serverThingspeak = "api.thingspeak.com"; //this is the Thingspeak address
String apiKeyThingspeak1 = "4UM3AXNO6QUYAHQO"; //Basement plenum control channel readings

char authBlynk[] = "a0b7b90a15794562959cf631f22225ce"; //insert token generated by Blynk

SimpleTimer timer;

void setup()
{
  Serial.begin(115200);
  Serial.println(F(""));
  Serial.println(F("BASEMENT VENTILATION PLENUM CONTROLLER - with Thingspeak & Blynk & Running Median & Email & Twitter"));
  Serial.print(F("File name: "));
  Serial.println(__FILE__);
  Serial.println();

  WiFi.begin(ssid, password);
  Serial.println(F("Where's some WiFi??"));
  while (WiFi.status() != WL_CONNECTED) {
    delay(500);
    Serial.print(F("."));
  }

  Serial.println(F(""));
  Serial.println(F("Found some WiFi!"));
  long rssi = WiFi.RSSI();
  Serial.print(F("WiFi signal strength (RSSI): "));
  Serial.print(rssi);
  Serial.println(F(" dBm"));
  Serial.println("");
  Serial.println(F("------------"));

  Blynk.begin(authBlynk, ssid, password);

  while (!Blynk.connect()) {
    // Wait until connected
  }
  Serial.println("After connect to blynk");
  timer.setInterval(2000, dataLogging); // Setup the data logging function to be called every 120 seconds (2 mins)
  timer.setInterval(6000, tweetUptime); // Setup Twitter uptime function to be called every 600 seconds (10 minutes)

}

void dataLogging()

{
  Serial.println(F("Starting data logging function (Blynk then Thingspeak)"));

  long rssi = WiFi.RSSI();
  Blynk.virtualWrite(V0, rssi); // this sends the WiFi Signal Strenght to Blynk

  long uptime = millis() / 60000;
  Blynk.virtualWrite(V20, uptime); // this sends the program uptime to Blynk

//  Serial.println(F("Sending to Blynk - BASEMENT readings"));
//  Blynk.virtualWrite(V4, baseHum ); // this sends the reading to the Blynk virtual pin
//  Serial.print(baseHum);
//  Serial.println("%");
//  Blynk.virtualWrite(V5, baseTemp); // this sends the reading to the Blynk virtual pin
//  Serial.print(baseTemp);
//  Serial.println("'C");
//  Blynk.virtualWrite(V6, baseDewPoint); // this sends the calculation to the Blynk virtual pin
//  Serial.print(baseDewPoint);
//  Serial.println("'C");
//  Blynk.virtualWrite(V19, medianBaseDewPoint); // this sends the calculation to the Blynk virtual pin
//  Serial.print(F("Basement Dew Point (median):"));
//  Serial.print(medianBaseDewPoint);
//  Serial.println("'C");

  Serial.println(F("Just finished the data logging Blynk section"));

  Serial.println(F("Preparing Thingspeak readings"));

  int h1 = analogRead(A0);
  //Đẩy dữ lên thingspeak
  if (client.connect(serverThingspeak,80)) {  //   "184.106.153.149" or api.thingspeak.com
    String postStr = apiKeyThingspeak1;
           postStr +="&field1=";
           postStr += String(h1);
           postStr += "\r\n\r\n";
 
     client.print("POST /update HTTP/1.1\n"); 
     client.print("Host: api.thingspeak.com\n"); 
     client.print("Connection: close\n"); 
     client.print("X-THINGSPEAKAPIKEY: "+apiKeyThingspeak1+"\n"); 
     client.print("Content-Type: application/x-www-form-urlencoded\n"); 
     client.print("Content-Length: "); 
     client.print(postStr.length()); 
     client.print("\n\n"); 
     client.print(postStr);
           
     Serial.print(" Analog value:  ");
     Serial.print(h1);
     Serial.println("% send to Thingspeak");    
  }
}

void tweetUptime()
{
  long uptime = millis() / 60000L;
  BLYNK_LOG("Tweeting every 10 minutes ;)");
  Blynk.tweet(String("Basement Controller running for ") + uptime + " minutes.");
}

void loop()
{
  Blynk.run(); // Initiates Blynk
  timer.run(); // Initiates SimpleTimer
}
